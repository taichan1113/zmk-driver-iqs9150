## dts/bindings/input/azoteq,iqs9150.yaml
```yaml
description: Azoteq IQS9150 capacitive trackpad controller

compatible: "azoteq,iqs9150"

include: i2c-device.yaml

properties:
  power-diagnostics:
    type: boolean
    description: |
      Read mode/ALP configuration before ATI and cache Info Flags from ordinary
      runtime reports. Cached observations never force I2C or wake the sensor;
      a stale value is not the current mode. No configuration tuning is performed.
      ATI前にmode/ALP設定を採取し、通常reportのInfo FlagsをRAM保存する。
      runtimeの追加通信・強制復帰は行わない。古い採取値は現在modeではない。
  power-mode-limit:
    type: string
    default: "none"
    enum: ["none", "active", "idle", "lp1"]
    description: |
      Deepest allowed automatic power mode. none preserves initialization data;
      active zeros all five mode timeouts; idle blocks Idle-to-LP1; lp1 blocks
      LP1-to-LP2. Modified timeouts are verified before ATI. Automatic reference
      management and sampling periods remain unchanged. This is a startup-only
      policy, not Zephyr suspend/resume. Legacy diagnostic flags take precedence.
      自動省電力段階の上限。noneは初期値維持、activeは全mode timeoutを0、
      idleはLP1移行停止、lp1はLP2移行停止。ATI前に変更箇所をreadback確認。
      起動時の設定で、sampling・自動reference管理は維持。旧診断設定が優先。
  diagnostic-disable-lp-entry:
    type: boolean
    description: |
      Diagnostic only: zero the Idle-to-LP1 timeout word at 0x11B0 and verify
      readback before ATI. Retain Active/Idle Touch/Idle transitions, sampling
      and automatic reference management. Leave diagnostic-disable-mode-timeouts
      absent for this comparison; if both are set, active-only takes precedence.
      診断専用：IdleからLP1へのtimeoutのみ0にし、ATI前にreadback確認する。
      他のmode timeoutとsampling・自動reference管理は維持する。
  diagnostic-disable-mode-timeouts:
    type: boolean
    description: |
      Diagnostic only: set five automatic mode timeouts (0x11AC through 0x11B5)
      to zero and verify readback before ATI. Sampling periods, Event Mode and
      automatic reference management are unchanged. Battery consumption increases.
      診断専用：5つの自動mode timeoutを0にし、ATI前にreadback確認する。
      sampling・Event Mode・自動reference管理は維持。電池消費は増える。
  rdy-watch-ms:
    type: int
    default: 250
    description: GPIO-only runtime RDY level check interval; zero disables. Inactive event-mode silence does not force I2C or reset.
  runtime-diagnostics:
    type: boolean
    description: Emit a runtime health line every ten seconds with RDY, IRQ, report, error and rescue counters.
  rdy-gpios:
    type: phandle-array
    required: true
    description: |
      GPIO connected to the IQS9150 RDY output. Specify GPIO_ACTIVE_LOW. RDY is active-low and
      open-drain. Put pull-up flags here only when the EV02 board does not
      provide the required external pull-up.
  two-finger-diagnostics:
    type: boolean
    description: |
      Emit throttled INFO logs of independent Finger 1/Finger 2 coordinates
      while two or more contacts are present. Intended for hardware validation.
  multitouch-diagnostics:
    type: boolean
    description: |
      Emit throttled INFO logs of all valid contacts while three or more
      contacts are present. Intended for multi-finger hardware validation.
```

## src/driver/iqs9150/Kconfig
```kconfig
menuconfig IQS9150_EV02_DRIVER
    bool "IQS9150 EV02 sensor driver"
    default y
    depends on DT_HAS_AZOTEQ_IQS9150_ENABLED
    select I2C
    help
      Initialize IQS9150 EV02 on the active-low RDY interrupt, then publish
      normalized absolute contact frames. Pointer and gesture policies are
      implemented by separate Travelers Pad function modules.

if IQS9150_EV02_DRIVER

config IQS9150_CONTACT_DIAGNOSTICS
    bool "Trace sensor contact flags before normalization"
    default n
    help
      Observe already-read sensor reports on count/slot-mask transitions and
      once per second while contacts remain present. No extra I2C reads are
      performed. Disable after diagnosis to reduce serial logging overhead.

module = IQS9150_EV02_DRIVER
module-str = iqs9150_ev02_driver
source "subsys/logging/Kconfig.template.log_config"

endif
```
